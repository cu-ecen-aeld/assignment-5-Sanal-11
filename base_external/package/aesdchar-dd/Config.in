## base_external/package/aesdchar-dd/Config.in
```kconfig
config BR2_PACKAGE_AESDCHAR_DD
	bool "aesdchar-dd"
	help
		Includes the char device driver.
```

## base_external/package/ldd/Config.in
```kconfig
config BR2_PACKAGE_AESD_ASSIGNMENTS
	bool "ldd-misc-modules"
	help
		Includes the misc and scull load and unload in the kernel image.
		Used to understand buildroot external trees and package builds.
```
